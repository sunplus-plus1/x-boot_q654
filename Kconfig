## Kconfig
```kconfig
choice
	prompt "Architecture select"
	default ARCH_ARM
	config ARCH_ARM
		bool "ARM architecture"
	config ARCH_RISCV
		bool "RISCV architecture"
endchoice

choice
	prompt "Platform"
	default PLATFORM_SP7350
	config PLATFORM_SP7350
		bool "SP7350"
endchoice

choice
	prompt "DDR SDRAM type"
	default LPDDR4
	depends on PLATFORM_SP7350
	config  LPDDR4
		bool "LPDDR4"
	config DDR4
		bool "DDR4"
	config LPDDR3
		bool "LPDDR3"
	config DDR3
		bool "DDR3"
endchoice

choice
	prompt "LPDDR4 SDRAM part number"
	depends on PLATFORM_SP7350 && LPDDR4
	config  NT6AN1024F32AV
		bool "Nayna NT6AN1024F32AV"
		help
		  Nanya NT6AN1024F32AV, 1Gbx32, 2 rank
	config MT53D1024M32D4
		bool "Micron MT53D1024M32D4 D9WHT"
		help
		  Micron MT53D1024M32D4, 1Gbx32, 2 rank, FBGA code = D9WHT
	config MT53E1G32D2_A
		bool "Micron MT53E1G32D2_A D9ZQX"
		help
		  Micron MT53E1G32D2_A, 1Gbx32, 1 rank, FBGA code = D9ZQX
	config MT53E1G32D2_B
		bool "Micron MT53E1G32D2_B D8CJG"
		help
		  Micron MT53E1G32D2_B, 1Gbx32, 2 rank, FBGA code = D8CJG
	config MT53E2G32D4_C
		bool "Micron MT53E2G32D4_C D8CJN"
		help
		  Micron MT53E2G32D4_C, 2Gbx32, 2 rank, FBGA code = D8CJN
		  MT53E2G32D4_C
	config RS1G32LO4D2BDS
		bool "Rayson RS1G32LO4D2DBS"
		help
		  Rayson RS1G32LO4D2DBS, 1Gbx32, 2 rank
	config HG4XD04G
		bool "Hosinglobal HG4XD04G"
		help
		  Hosinglobal HG4XD04G, 1Gbx32, 2 rank
	config BWMZCX32H2A
		bool "Biwin BWMZCX32H2A"
		help
		  Biwin BWMZCX32H2A, 1Gbx32, 1 rank
	config EM6LH32MVAJA
		bool "Etron EM6LH32MVAJA"
		help
		  Etron EM6LH32MVAJA, 1Gbx32, 1 rank
	config RS512M32LO4D1BDS
		bool "Rayson RS512M32LO4D1BDS"
		help
		  Rayson RS512M32LO4D1BDS, 512Mbx32, 1 rank
	config IS43LQ32K01B
		bool "ISSI IS43LQ32K01B"
		help
		  ISSI IS43LQ32K01B, 512Mbx32, 1 rank
endchoice

choice
	prompt "DDR4 SDRAM part number"
	depends on PLATFORM_SP7350 && DDR4
	config MT40A512M16TB
		bool "Micron MT40A512M16TB D8BPK"
		help
		  Micron MT40A512M16TB, 512Mx16, 1 rank, FBGA code = D8BPK
	config K4AAG165WA
		bool "Samsung K4AAG165WA"
		help
		  SAMSUNG K4AAG165WA, 1Gx16, 1 rank
endchoice

choice
	prompt "LPDDR3 SDRAM part number"
	depends on PLATFORM_SP7350 && LPDDR3
endchoice

choice
	prompt "DDR3 SDRAM part number"
	depends on PLATFORM_SP7350 && DDR3
	config MT41K512M16VRP
		bool "Micron MT41K512M16VRP D9ZWN"
		help
		  Micron MT41K512M16VRP, 512Mx16, 1 rank, FBGA code = D9ZWN
	config K4B8G1646D
		bool "Samsung K4B8G1646D"
		help
		  SAMSUNG K4B8G1646D, 512Mx16, 2 rank
endchoice

config PLATFORM_IC_REV
	int "IC revision number"
	range 1 2
	default 1
	help
	  IC revision number. First IC is 1.
	  A new IC revision may have a different SRAM layout.

config XIP_SPIBAREMETAL
	bool "iBoot is XIP on SPI NOR (SPI Baremetal Boot)"
	help
	  Select if iBoot is XIP on SPI_NOR.

config BOOT_ON_CSIM
	bool "Build for CSIM"

config BOOT_ON_ZEBU
	bool "Boot on Zebu"
	depends on BOOT_ON_CSIM

config USE_ZMEM
	bool "Use ZMEM to skip image loading"
	depends on BOOT_ON_ZEBU

config HAVE_UART_BOOTSTRAP
	bool "UART Bootstrap"
	default y

config HAVE_USB_DISK
	bool "USB2 disk driver"
	select HAVE_FS_FAT
	help
	  Sunplus EHCI dirver, need to disable HAVE_SNPS_USB3_DISK

config HAVE_USB_HUB
	bool "USB2 hub supported"
	depends on HAVE_USB_DISK

config HAVE_SNPS_USB3_DISK
	bool "Synopsys USB 3.1 disk driver"
	select HAVE_FS_FAT
	help
	  Sunplus synopsys XHCI dirver, need to disable HAVE_USB_DISK

config HAVE_USB3_HUB
	bool "USB hub supported by xhci"
	depends on HAVE_SNPS_USB3_DISK

config HAVE_OTP
	bool "OTP driver"

config HAVE_OTP_HS
	bool "OTP driver handshake"
	select HAVE_OTP
	help
	   Enable OTP handshake.

config HAVE_MMC
	bool "MMC common"
	help
	  Common MMC code for SD Card or eMMC.

config HAVE_I2C
	bool "I2C driver"
	depends on PLATFORM_SP7350
	help
	  I2C driver.

config HAVE_ADC
	bool "ADC driver"
	depends on PLATFORM_SP7350
	help
	  ADC driver.

config HAVE_SDCARD
	bool "SD Card driver"
	select HAVE_MMC
	select HAVE_FS_FAT

config HAVE_EMMC
	bool "eMMC driver"
	select HAVE_MMC

config HAVE_NAND_COMMON
	bool "NAND common"
	help
	  Common NAND code, like BCH support.

config HAVE_PARA_NAND
	bool "Parallel NAND"
	select HAVE_NAND_COMMON

config HAVE_SPI_NAND
	bool "SPI NAND"
	select HAVE_NAND_COMMON

config HAVE_FS_FAT
	bool "FAT32 filesystem"
	depends on HAVE_USB_DISK || HAVE_SNPS_USB3_DISK || HAVE_SDCARD

config HAVE_FS_FAT16
	bool "FAT16 filesystem"
	depends on HAVE_USB_DISK || HAVE_SNPS_USB3_DISK || HAVE_SDCARD

config HAVE_SPI_NOR
	bool "SPI NOR boot"
	default y

config HAVE_MON_SHELL
	bool "MON Shell"
	default y

config DEBUG_WITH_2ND_UART
	bool "Use 2nd UART as debug port"
	depends on HAVE_MON_SHELL

config STANDALONE_DRAMINIT
	bool "Use standalone draminit bin (depricated)"
	help
	  If yes, load and run draminit image at run-time.
	  If no, link draminit obj into xboot.

config PREBUILT_DRAMINIT_OBJ
	string "Provide pebuilt draminit obj path"
	depends on !STANDALONE_DRAMINIT
	default ""
	help
	  If empty, use recent ../draminit/plf_dram.o.

config HAVE_ARCH_FASTMEM
	bool "Use memset/memcpy fast assembly code"
	default y

config USE_ROM_SHARE
	bool "Use rom share"
	depends on PLATFORM_SP7350

config LOAD_BL31
	bool "Load and run BL31 (Secure Monitor)"
	default y
	depends on PLATFORM_SP7350

menu "Experiments"
	config A64_EL1
		bool "Drop from EL3 to EL1 in xBoot"
		depends on PLATFORM_SP7350
		help
		  By default, xboot is at EL3 AArch64.
		  Select this option to drop xBoot to NS-EL1(default)
		  or S-EL1 (please modify SCR_VALUE).

	config LOAD_LINUX
		bool "Load and run Linux"
	config LOAD_DTB
		bool "Load DTB (if Linux has no builtin DTB)"
		depends on LOAD_LINUX && !ARCH_NDS

endmenu

config SECURE_BOOT_SIGN
	bool "Sign image to enable Secure Boot"
	select HAVE_OTP
	help
	  Sign xboot image and append generated signature to it.
	  If IC OTP secure boot bit is enabled, ROM code only boots
	  signed xboot image.

config REGULATOR_RT5759
	bool "Richtek RT5759 Regulator"
	depends on HAVE_I2C
	help
	  This adds support for voltage regulator Richtek RT5759.

config REGULATOR_STI8070X
	bool "TOLL Microelectronic STI8070x Regulators"
	depends on HAVE_I2C
	help
	  This adds support for voltage regulator STI8070x series.

choice
	prompt "Ethernet PHY Mode"
	default PHY_RGMII_MODE
	depends on PLATFORM_SP7350
	config  PHY_RGMII_MODE
		bool "RGMII"
		help
		  Select RGMII interface for PHY.
	config PHY_RMII_MODE
		bool "RMII"
		help
		  Select RMII interface for PHY.
endchoice

config AP6256_WL_REG_ON_GPIO56
	bool "Enable AP6256 WL_REG_ON control using GPIO56"
	help
	  Say "y" if you want to control WL_REG_ON signal using
	  GPIO56.
choice
	prompt "CPIO Mode"
	default CPIO_OFF_MODE
	depends on PLATFORM_SP7350
	config  CPIO_OFF_MODE
		bool "Off"
		help
		  Turn off CPIO interface.
	config  CPIO_MASTER_MODE
		bool "Master"
		help
		  Select CPIO interface to work at Master mode.
	config CPIO_SLAVE_MODE
		bool "Slave"
		help
		  Select CPIO interface to work at Slave mode.
endchoice
```
